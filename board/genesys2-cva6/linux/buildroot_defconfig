## board/genesys2-cva6/linux/buildroot_defconfig
```kconfig
# Genesys2 CVA6 Buildroot source-lock defconfig for the next SD-card Linux rebuild.
# This file is a repo-local source input, not proof of the currently booted SD card.
BR2_riscv=y
BR2_RISCV_64=y
BR2_RISCV_ISA_RVA=y
BR2_RISCV_ISA_RVC=y
BR2_RISCV_ISA_RVD=y
BR2_RISCV_ISA_RVF=y
BR2_RISCV_ABI_LP64D=y
BR2_TOOLCHAIN_BUILDROOT_GLIBC=y
BR2_TOOLCHAIN_BUILDROOT_CXX=y
BR2_TARGET_GENERIC_HOSTNAME="genesys2-cva6"
BR2_TARGET_GENERIC_ISSUE="Genesys2 CVA6 Buildroot Linux"
BR2_SYSTEM_DHCP="eth0"
BR2_LINUX_KERNEL=y
BR2_LINUX_KERNEL_CUSTOM_VERSION=y
BR2_LINUX_KERNEL_CUSTOM_VERSION_VALUE="6.19.6"
BR2_PACKAGE_HOST_LINUX_HEADERS_CUSTOM_6_19=y
BR2_LINUX_KERNEL_USE_CUSTOM_CONFIG=y
BR2_LINUX_KERNEL_CUSTOM_CONFIG_FILE="$(RVMT_ROOT)/board/genesys2-cva6/linux/linux.config"
BR2_LINUX_KERNEL_DTS_SUPPORT=y
BR2_LINUX_KERNEL_USE_CUSTOM_DTS=y
BR2_LINUX_KERNEL_CUSTOM_DTS_PATH="$(RVMT_ROOT)/build/linux/genesys2-cva6/cv64a6.generated.dts"
BR2_TARGET_OPENSBI=y
BR2_TARGET_OPENSBI_CUSTOM_VERSION=y
BR2_TARGET_OPENSBI_CUSTOM_VERSION_VALUE="1.7"
BR2_TARGET_OPENSBI_PLAT="generic"
BR2_TARGET_OPENSBI_INSTALL_PAYLOAD_IMG=y
BR2_TARGET_OPENSBI_LINUX_PAYLOAD=y
BR2_TARGET_ROOTFS_EXT2=y
BR2_TARGET_ROOTFS_EXT2_4=y
BR2_TARGET_ROOTFS_EXT2_SIZE="512M"
BR2_TARGET_ROOTFS_CPIO=y
BR2_TARGET_ROOTFS_TAR=y
BR2_PACKAGE_BUSYBOX=y
BR2_PACKAGE_DROPBEAR=y
BR2_PACKAGE_HTOP=y
BR2_PACKAGE_STRACE=y
BR2_PACKAGE_PCIUTILS=y
BR2_PACKAGE_UTIL_LINUX=y
BR2_PACKAGE_UTIL_LINUX_LSBLK=y
BR2_PACKAGE_UTIL_LINUX_MOUNT=y
BR2_PACKAGE_UTIL_LINUX_UMOUNT=y
BR2_PACKAGE_KMOD=y
BR2_PACKAGE_LIBELF=y
BR2_PACKAGE_ZLIB=y
BR2_PACKAGE_OPENSSL=y
BR2_PACKAGE_PYTHON3=y
```
